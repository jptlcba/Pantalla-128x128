#include <Arduino.h>
#include <WiFi.h>
#include <wire.h>
#include <ESP32Encoder.h>
#include <Adafruit_SSD1327.h>
#include <Arduino_MQTT_Client.h>
#include <ThingsBoard.h>
#include <DallasTemperature.h>

// Used for software SPI
//#define OLED_CLK 13
//#define OLED_MOSI 11

// Used for software or hardware SPI
//#define OLED_CS 5
//#define OLED_DC 17

// Used for I2C or SPI
#define OLED_RESET -1
#define ENC_CLK 35
#define ENC_D0  34
#define SWITCH  32
#define STEP    18
#define DIR      5 
#define DS18B20 4


#define TOKEN "Cocina"
#define THINGSBOARD_SERVER "mqtt.thingsboard.cloud"     //"192.168.0.20"
#define THINGSBOARD_PORT "1883"

// Datos para configurar WIFI
#define ssid "T1"
#define password "tadetade2007"

// Initialize ThingsBoard instance
WiFiClient espClient;

Arduino_MQTT_Client mqttClient(espClient); 

const std::array<IAPI_Implementation*, 0U> apis = {};
ThingsBoard tb(mqttClient, 128, 128, Default_Max_Stack_Size, apis);

OneWire oneWire(DS18B20);
DallasTemperature sensors(&oneWire);

DeviceAddress temp_1; //= {0x28, 0xDC, 0xFB, 0x3F, 0x00, 0x00, 0x00, 0xA3};



int Valvula = 0;
char buffer[6];
float temp = 0;
int c;
int prueba_git;

ESP32Encoder encoder;

// software SPI
//Adafruit_SSD1327 display(128, 128, OLED_MOSI, OLED_CLK, OLED_DC, OLED_RESET, OLED_CS);
// hardware SPI
//Adafruit_SSD1327 display(128, 128, &SPI, OLED_DC, OLED_RESET, OLED_CS);

void printAddress(DeviceAddress);
void printTemperatura(DeviceAddress);


// I2C
Adafruit_SSD1327 display(128, 128, &Wire, OLED_RESET, 1000000);


// Decalaracion de funciones
//***************************************************
void testdrawchar(void);
void testdrawcircle(void);
void testfillrect(void);
void testdrawtriangle(void);
void testfilltriangle(void);
void testdrawroundrect(void);
void testfillroundrect(void);
void testdrawrect(void);
void testdrawline();
//***************************************************

#define NUMFLAKES 10
#define XPOS 0
#define YPOS 1
#define DELTAY 2


#define LOGO16_GLCD_HEIGHT 16 
#define LOGO16_GLCD_WIDTH  16 
static const unsigned char PROGMEM logo16_glcd_bmp[] =
{ B00000000, B11000000,
  B00000001, B11000000,
  B00000001, B11000000,
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  B00000000, B00110000 };

// 'Pant_128x128_2', 128x128px
const unsigned char epd_bitmap_Pant_128x128_2 [] PROGMEM = {
	0x00, 0x00, 0x00, 0x00, 0x00, 0x00, 0x00, 0x1f, 0xff, 0xff, 0xff, 0xff, 0xff, 0xff, 0xff, 0xff, 
	0x00, 0x00, 0x00, 0x00, 0x00, 0x00, 0x00, 0x1f, 0xff, 0xff, 0xff, 0xff, 0xff, 0xff, 0xff, 0xff, 
	0x00, 0x00, 0x00, 0x00, 0x00, 0x00, 0x00, 0x0f, 0xff, 0xff, 0xff, 0xff, 0xff, 0xff, 0xff, 0xff, 
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	0x00, 0x00, 0x00, 0x00, 0x00, 0x00, 0x00, 0x00, 0x00, 0x00, 0x00, 0x00, 0x00, 0x00, 0x00, 0x00
};


void InitWiFi()
{
  if (WiFi.status() != WL_CONNECTED)
  {
    WiFi.begin(ssid, password);
    delay(3000);
  }
  else
  Serial.println("Me conecté");
}

void reconnect()
{
  // Loop until we're reconnected
  if (WiFi.status() != WL_CONNECTED)
  {
    WiFi.begin(ssid, password);
    delay(1000);
  }
}



  int y;

void setup()   {           
  pinMode(SWITCH, INPUT_PULLUP);  
  pinMode(ENC_CLK, INPUT);        // Endoder A
  pinMode(ENC_CLK, INPUT);      
  pinMode(STEP, OUTPUT);
  pinMode(DIR, OUTPUT);
  encoder.attachHalfQuad(ENC_CLK, ENC_D0);
  encoder.setCount(10);
  Serial.begin(115200);
  while (! Serial) delay(100);
  Serial.println("SSD1327 OLED test");
  
  if ( ! display.begin(0x3D) ) {     //display.begin(0x3D)
    // Serial.println("Unable to initialize OLED");
     while (1) yield();
     }

  display.clearDisplay();
  display.display();
  y=0;
  c=0;

  if (!sensors.getAddress(temp_1, 0)) Serial.println("Unable to find address for Device 0");
  Serial.print("\n\nDevice 0 Address: ");
  printAddress(temp_1);
  Serial.println();

 display.clearDisplay();
 display.drawBitmap(0, 0, epd_bitmap_Pant_128x128_2, 128, 128, 15);
 display.display();
 delay(500);

 InitWiFi();

}

void loop() {
  delay(1000);


   if (WiFi.status() != WL_CONNECTED)
  {
    Serial.println("parece que no se conectó");
    reconnect();
  }

// analizo si esta conectado al tb
  if (!tb.connected())
  {
    // Connect to the ThingsBoard
    Serial.print("Connecting to: ");
    Serial.print(THINGSBOARD_SERVER);
    Serial.print(" with token ");
    Serial.println(TOKEN);
    if (!tb.connect(THINGSBOARD_SERVER, TOKEN))
    {
      Serial.println("No se conecta a Thingsboard");
      //return;
    }
  }
    // miniature bitmap display

    sensors.requestTemperatures();
  temp = sensors.getTempC(temp_1);
    
    display.clearDisplay();
     display.setTextSize(2);
    display.setTextColor(15);
    display.setCursor(0,0);
    display.println("INVERTER");
    //display.setCursor(0,20);
    //display.println(y);
  
    Valvula = encoder.getCount();
    sprintf(buffer, "%4d", Valvula);  // ancho fijo de 4
    display.setCursor(0,40);
    display.print("Valv:");
    display.print(buffer);


    display.setCursor(0,80);
    display.print("TEMP:");
    sprintf(buffer, "%5.2f", temp);
    display.print(buffer);
    
    display.drawBitmap(112, y,  logo16_glcd_bmp, 16, 16, 15);
    display.display();
    

    if(temp>=-30 && temp<=100)
    {
      c++;
      if(c==10)
      {
        tb.sendTelemetryData("temp", temp);
        Serial.println("Sending temperature data...");
        c=0;
      } 
    }

  tb.loop();
 }
  

void testdrawchar(void) {
  display.setTextSize(1);
  display.setTextWrap(false);
  display.setTextColor(SSD1327_WHITE);
  display.setCursor(0,0);

  for (uint8_t i=0; i < 168; i++) {
    if (i == '\n') continue;
    display.write(i);
    if ((i > 0) && (i % 21 == 0))
      display.println();
  }    
  display.display();
}

void testdrawcircle(void) {
  for (uint8_t i=0; i<display.height(); i+=2) {
    display.drawCircle(display.width()/2, display.height()/2, i, i % 15 + 1);
    display.display();
  }
}

void testfillrect(void) {
  uint8_t color = 1;
  for (uint8_t i=0; i<display.height()/2; i+=3) {
    // alternate colors
    display.fillRect(i, i, display.width()-i*2, display.height()-i*2,  i % 15 + 1);
    display.display();
    color++;
  }
}

void testdrawtriangle(void) {
  for (uint16_t i=0; i<min(display.width(),display.height())/2; i+=5) {
    display.drawTriangle(display.width()/2, display.height()/2-i,
                     display.width()/2-i, display.height()/2+i,
                     display.width()/2+i, display.height()/2+i,  i % 15 + 1);
    display.display();
  }
}

void testfilltriangle(void) {
  // uint8_t color = SSD1327_WHITE;
  for (int16_t i=min(display.width(),display.height())/2; i>0; i-=5) {
    display.fillTriangle(display.width()/2, display.height()/2-i,
                     display.width()/2-i, display.height()/2+i,
                     display.width()/2+i, display.height()/2+i,  i % 15 + 1);
    display.display();
  }
}

void testdrawroundrect(void) {
  for (uint8_t i=0; i<display.height()/3-2; i+=2) {
    display.drawRoundRect(i, i, display.width()-2*i, display.height()-2*i, display.height()/4,  i % 15 + 1);
    display.display();
  }
}

void testfillroundrect(void) {
  // uint8_t color = SSD1327_WHITE;
  for (uint8_t i=0; i<display.height()/3-2; i+=2) {
    display.fillRoundRect(i, i, display.width()-2*i, display.height()-2*i, display.height()/4,  i % 15 + 1);
    display.display();
  }
}
   
void testdrawrect(void) {
  for (uint8_t i=0; i<display.height()/2; i+=2) {
    display.drawRect(i, i, display.width()-2*i, display.height()-2*i, i % 15 + 1);
    display.display();
  }
}

void testdrawline() {  
  for (uint8_t i=0; i<display.width(); i+=4) {
    display.drawLine(0, 0, i, display.height()-1, SSD1327_WHITE);
    display.display();
  }
  for (uint8_t i=0; i<display.height(); i+=4) {
    display.drawLine(0, 0, display.width()-1, i, SSD1327_WHITE);
    display.display();
  }
  delay(250);
  
  display.clearDisplay();
  for (uint8_t i=0; i<display.width(); i+=4) {
    display.drawLine(0, display.height()-1, i, 0, SSD1327_WHITE);
    display.display();
  }
  for (int8_t i=display.height()-1; i>=0; i-=4) {
    display.drawLine(0, display.height()-1, display.width()-1, i, SSD1327_WHITE);
    display.display();
  }
  delay(250);
  
  display.clearDisplay();
  for (int8_t i=display.width()-1; i>=0; i-=4) {
    display.drawLine(display.width()-1, display.height()-1, i, 0, SSD1327_WHITE);
    display.display();
  }
  for (int8_t i=display.height()-1; i>=0; i-=4) {
    display.drawLine(display.width()-1, display.height()-1, 0, i, SSD1327_WHITE);
    display.display();
  }
  delay(250);

  display.clearDisplay();
  for (uint8_t i=0; i<display.height(); i+=4) {
    display.drawLine(display.width()-1, 0, 0, i, SSD1327_WHITE);
    display.display();
  }
  for (uint8_t i=0; i<display.width(); i+=4) {
    display.drawLine(display.width()-1, 0, i, display.height()-1, SSD1327_WHITE); 
    display.display();
  }
  delay(250);
}

 // function to print a device address
void printAddress(DeviceAddress deviceAddress)
{
  for (uint8_t i = 0; i < 8; i++)
  {
    // zero pad the address if necessary
    if (deviceAddress[i] < 0x10) Serial.print("0");
    Serial.print(deviceAddress[i], HEX);
  }
}

void printTemperatura(DeviceAddress deviceAddress){
float tempC = sensors.getTempC(deviceAddress);
if(tempC == -127.00){
	Serial.print("Error leyendo temperatura");
}
else {
	Serial.print("C: ");
	Serial.print(tempC);
	}
}